## CMakeLists.txt
```
# SPDX-License-Identifier: Apache-2.0

cmake_minimum_required(VERSION 3.20.0)
find_package(Zephyr REQUIRED HINTS $ENV{ZEPHYR_BASE})
project(appkituesamer)

target_sources(
    app PRIVATE src/main.c
    src/ssd1306/ssd1306.c
    src/sensors/sensors.c
    src/mpu6050/mpu6050.c
    src/bmp280/bmp280.c
    src/utilities/utilities.c)
```

## sample.yaml
```
sample:
  name: App qui tue ça mère
tests:
  sample.basic.blinky:
    tags:
      - LED
      - gpio
    filter: dt_enabled_alias_with_parent_compat("led0", "gpio-leds")
    depends_on: gpio
    harness: led
    integration_platforms:
      - frdm_k64f
```

## prj.conf
```kconfig
CONFIG_GPIO=y
CONFIG_I2C=y
CONFIG_I2C_TARGET=y
CONFIG_I2C_DUMP_MESSAGES=y
CONFIG_I2C_LOG_LEVEL_DBG=y
```

## src/main.c
```c
#include <zephyr/kernel.h>
#include <zephyr/sys/printk.h>

#include <stdio.h>

#include "ssd1306/ssd1306.h"
#include "mpu6050/mpu6050.h"
#include "bmp280/bmp280.h"
#include "utilities/utilities.h"



int main(void)
{
	uint8_t reg = 0x75; 
	uint8_t data[3];
	scan_device_i2c();
	
	mpu6050_init();
	// première lecture d'initialisation
	int temp = bmp280_read_temp();
	MPU6050 mpu6050 = mpu6050_read_all();

	
	init_OLED();
	display_data(temp, mpu6050);

	// opérations séquentielles
	while(1){
		int temp = bmp280_read_temp();
		MPU6050 mpu6050 = mpu6050_read_all();
		display_data(temp, mpu6050);
	}

	return 0;
}
```

## src/font5x8.h
```c
static const uint8_t font5x8[95][5] = {
  { 0x00, 0x00, 0x00, 0x00, 0x00 },  // ' '
  { 0x00, 0x00, 0x5F, 0x00, 0x00 },  // '!'
  { 0x00, 0x07, 0x00, 0x07, 0x00 },  // '"'
  { 0x14, 0x7F, 0x14, 0x7F, 0x14 },  // '#'
  { 0x24, 0x2A, 0x7F, 0x2A, 0x12 },  // '$'
  { 0x23, 0x13, 0x08, 0x64, 0x62 },  // '%'
  { 0x36, 0x49, 0x55, 0x22, 0x50 },  // '&'
  { 0x00, 0x00, 0x07, 0x00, 0x00 },  // '''
  { 0x00, 0x1C, 0x22, 0x41, 0x00 },  // '('
  { 0x00, 0x41, 0x22, 0x1C, 0x00 },  // ')'
  { 0x14, 0x08, 0x3E, 0x08, 0x14 },  // '*'
  { 0x08, 0x08, 0x3E, 0x08, 0x08 },  // '+'
  { 0x00, 0xA0, 0x60, 0x00, 0x00 },  // ','
  { 0x08, 0x08, 0x08, 0x08, 0x08 },  // '-'
  { 0x00, 0x60, 0x60, 0x00, 0x00 },  // '.'
  { 0x20, 0x10, 0x08, 0x04, 0x02 },  // '/'
  { 0x3E, 0x51, 0x49, 0x45, 0x3E },  // '0'
  { 0x00, 0x42, 0x7F, 0x40, 0x00 },  // '1'
  { 0x42, 0x61, 0x51, 0x49, 0x46 },  // '2'
  { 0x21, 0x41, 0x45, 0x4B, 0x31 },  // '3'
  { 0x18, 0x14, 0x12, 0x7F, 0x10 },  // '4'
  { 0x27, 0x45, 0x45, 0x45, 0x39 },  // '5'
  { 0x3C, 0x4A, 0x49, 0x49, 0x30 },  // '6'
  { 0x01, 0x71, 0x09, 0x05, 0x03 },  // '7'
  { 0x36, 0x49, 0x49, 0x49, 0x36 },  // '8'
  { 0x06, 0x49, 0x49, 0x29, 0x1E },  // '9'
  { 0x00, 0x63, 0x63, 0x00, 0x00 },  // ':'
  { 0x00, 0xA3, 0x63, 0x00, 0x00 },  // ';'
  { 0x08, 0x14, 0x22, 0x41, 0x00 },  // '<'
  { 0x14, 0x14, 0x14, 0x14, 0x14 },  // '='
  { 0x00, 0x41, 0x22, 0x14, 0x08 },  // '>'
  { 0x02, 0x01, 0x51, 0x09, 0x06 },  // '?'
  { 0x32, 0x49, 0x79, 0x41, 0x3E },  // '@'
  { 0x7E, 0x11, 0x11, 0x11, 0x7E },  // 'A'
  { 0x7F, 0x49, 0x49, 0x49, 0x36 },  // 'B'
  { 0x3E, 0x41, 0x41, 0x41, 0x22 },  // 'C'
  { 0x7F, 0x41, 0x41, 0x22, 0x1C },  // 'D'
  { 0x7F, 0x49, 0x49, 0x49, 0x41 },  // 'E'
  { 0x7F, 0x09, 0x09, 0x09, 0x01 },  // 'F'
  { 0x3E, 0x41, 0x49, 0x49, 0x7A },  // 'G'
  { 0x7F, 0x08, 0x08, 0x08, 0x7F },  // 'H'
  { 0x00, 0x41, 0x7F, 0x41, 0x00 },  // 'I'
  { 0x20, 0x40, 0x41, 0x3F, 0x01 },  // 'J'
  { 0x7F, 0x08, 0x14, 0x22, 0x41 },  // 'K'
  { 0x7F, 0x40, 0x40, 0x40, 0x40 },  // 'L'
  { 0x7F, 0x02, 0x0C, 0x02, 0x7F },  // 'M'
  { 0x7F, 0x04, 0x08, 0x10, 0x7F },  // 'N'
  { 0x3E, 0x41, 0x41, 0x41, 0x3E },  // 'O'
  { 0x7F, 0x09, 0x09, 0x09, 0x06 },  // 'P'
  { 0x3E, 0x41, 0x51, 0x21, 0x5E },  // 'Q'
  { 0x7F, 0x09, 0x19, 0x29, 0x46 },  // 'R'
  { 0x46, 0x49, 0x49, 0x49, 0x31 },  // 'S'
  { 0x01, 0x01, 0x7F, 0x01, 0x01 },  // 'T'
  { 0x3F, 0x40, 0x40, 0x40, 0x3F },  // 'U'
  { 0x1F, 0x20, 0x40, 0x20, 0x1F },  // 'V'
  { 0x3F, 0x40, 0x38, 0x40, 0x3F },  // 'W'
  { 0x63, 0x14, 0x08, 0x14, 0x63 },  // 'X'
  { 0x07, 0x08, 0x70, 0x08, 0x07 },  // 'Y'
  { 0x61, 0x51, 0x49, 0x45, 0x43 },  // 'Z'
  { 0x00, 0x7F, 0x41, 0x41, 0x00 },  // '['
  { 0x02, 0x04, 0x08, 0x10, 0x20 },  // '\'
  { 0x00, 0x41, 0x41, 0x7F, 0x00 },  // ']'
  { 0x04, 0x02, 0x01, 0x02, 0x04 },  // '^'
  { 0x40, 0x40, 0x40, 0x40, 0x40 },  // '_'
  { 0x00, 0x01, 0x02, 0x04, 0x00 },  // '`'
  { 0x20, 0x54, 0x54, 0x54, 0x78 },  // 'a'
  { 0x7F, 0x48, 0x44, 0x44, 0x38 },  // 'b'
  { 0x38, 0x44, 0x44, 0x44, 0x20 },  // 'c'
  { 0x38, 0x44, 0x44, 0x48, 0x7F },  // 'd'
  { 0x38, 0x54, 0x54, 0x54, 0x18 },  // 'e'
  { 0x08, 0x7E, 0x09, 0x01, 0x02 },  // 'f'
  { 0x18, 0xA4, 0xA4, 0xA4, 0x7C },  // 'g'
  { 0x7F, 0x08, 0x04, 0x04, 0x78 },  // 'h'
  { 0x00, 0x44, 0x7D, 0x40, 0x00 },  // 'i'
  { 0x40, 0x80, 0x84, 0x7D, 0x00 },  // 'j'
  { 0x7F, 0x10, 0x28, 0x44, 0x00 },  // 'k'
  { 0x00, 0x41, 0x7F, 0x40, 0x00 },  // 'l'
  { 0x7C, 0x04, 0x18, 0x04, 0x78 },  // 'm'
  { 0x7C, 0x08, 0x04, 0x04, 0x78 },  // 'n'
  { 0x38, 0x44, 0x44, 0x44, 0x38 },  // 'o'
  { 0xFC, 0x24, 0x24, 0x24, 0x18 },  // 'p'
  { 0x18, 0x24, 0x24, 0x14, 0xFC },  // 'q'
  { 0x7C, 0x08, 0x04, 0x04, 0x08 },  // 'r'
  { 0x48, 0x54, 0x54, 0x54, 0x20 },  // 's'
  { 0x04, 0x3F, 0x44, 0x40, 0x20 },  // 't'
  { 0x3C, 0x40, 0x40, 0x20, 0x7C },  // 'u'
  { 0x1C, 0x20, 0x40, 0x20, 0x1C },  // 'v'
  { 0x3C, 0x40, 0x30, 0x40, 0x3C },  // 'w'
  { 0x44, 0x28, 0x10, 0x28, 0x44 },  // 'x'
  { 0x1C, 0xA0, 0xA0, 0xA0, 0x7C },  // 'y'
  { 0x44, 0x64, 0x54, 0x4C, 0x44 },  // 'z'
  { 0x00, 0x08, 0x36, 0x41, 0x00 },  // '{'
  { 0x00, 0x00, 0x7F, 0x00, 0x00 },  // '|'
  { 0x00, 0x41, 0x36, 0x08, 0x00 },  // '}'
  { 0x06, 0x09, 0x09, 0x06, 0x00 },  // '~' remplacé par '°'
};
```

## src/global_variables.h
```c
#ifndef GLOBAL_VARIABLES_H
#define GLOBAL_VARIABLES_H

#include "zephyr/drivers/i2c.h"
// toutes les addresses des capteurs et registres de données de chaque valeur nécessaire

#define BMP280_ADDR 0x76
#define MPU6050_ADDR 0x68

#define BMP280_TEMP_REG_MSB 0xFA

#define MPU6050_GYRO_X   0x43 // MSB REG
#define MPU6050_GYRO_Y   0x45 // MSB REG
#define MPU6050_GYRO_Z   0x47 // MSB REG

#define MPU6050_ACCEL_X  0x3B // MSB REG
#define MPU6050_ACCEL_Y  0x3D // MSB REG
#define MPU6050_ACCEL_Z  0x3F // MSB REG


#define SSD1306_ADDR    0x3C
#define SSD1306_WIDTH   128
#define SSD1306_HEIGHT   64
#define SSD1306_COL_OFFSET 2

static const struct device *bus = DEVICE_DT_GET(DT_NODELABEL(i2c1));
// structure pour sticker les données du mpu6050
typedef struct Accelerometer // En m/s
{
	float x, y, z;
} Accelerometer;

typedef struct Gyro // E degrée
{
	float x, y, z;
} Gyro;

typedef struct MPU6050
{

	Gyro gyro;
	Accelerometer accel;
	int temp;

} MPU6050;

#endif
```
